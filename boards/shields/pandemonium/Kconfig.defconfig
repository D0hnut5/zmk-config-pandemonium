## boards/shields/pandemonium/Kconfig.defconfig
```kconfig
if SHIELD_PANDEMONIUM_DONGLE

config ZMK_KEYBOARD_NAME
    default "PANDEMONIUM"

config ZMK_SPLIT_ROLE_CENTRAL
    default y

config ZMK_SPLIT_BLE_CENTRAL_PERIPHERALS
    default 1

endif

if SHIELD_PANDEMONIUM_DONGLE || SHIELD_PANDEMONIUM

config ZMK_KEYBOARD_NAME
    default "PANDEMONIUM"

endif
```

## config/west.yml
```yaml
manifest:
  remotes:
    - name: zmkfirmware
      url-base: https://github.com/zmkfirmware
    # Additional modules containing boards/shields/custom code can be listed here as well
    # See https://docs.zephyrproject.org/3.2.0/develop/west/manifest.html#projects
    - name: carrefinho                           # prospector line
      url-base: https://github.com/carrefinho    # prospector line
  projects:
    - name: zmk
      remote: zmkfirmware
      revision: main
      import: app/west.yml
    - name: prospector-zmk-module               # prospector line
      remote: carrefinho                        # prospector line
      revision: main                            # prospector line
  self:
    path: config
```
